## config/west.yml
```yaml
manifest:
  remotes:
    - name: zmkfirmware
      url-base: https://github.com/zmkfirmware
  projects:
    # ZMK's manifest references the moving v4.1.0+zmk-fixes branch. Override
    # it with the Zephyr revision used by the known-good January 2026 build.
    - name: zephyr
      remote: zmkfirmware
      revision: ec36516990d40355238db3049bc1709191f99b4e
      clone-depth: 1
      import:
        name-blocklist:
          - ci-tools
          - hal_altera
          - hal_cypress
          - hal_infineon
          - hal_microchip
          - hal_nxp
          - hal_openisa
          - hal_xtensa
          - hal_st
          - hal_ti
          - loramac-node
          - mcuboot
          - mcumgr
          - net-tools
          - openthread
          - edtt
          - trusted-firmware-m
    - name: zmk
      remote: zmkfirmware
      revision: 354cff9c36b49eee6abbb8a61e6b927539aebbf2
      import: app/west.yml
  self:
    path: config
    west-commands: scripts/west-commands.yml
```

## modules/dao/boards/dao/dao_left/Kconfig.dao_left
```kconfig
# Copyright (c) 2021 Rafael Yumagulov
# SPDX-License-Identifier: MIT

config BOARD_DAO_LEFT
	select SOC_NRF52840_QIAA if BOARD_DAO_LEFT_NRF52840
```

## modules/dao/boards/dao/dao_right/Kconfig.dao_right
```kconfig
# Copyright (c) 2021 Rafael Yumagulov
# SPDX-License-Identifier: MIT

config BOARD_DAO_RIGHT
	select SOC_NRF52840_QIAA if BOARD_DAO_RIGHT_NRF52840
```
